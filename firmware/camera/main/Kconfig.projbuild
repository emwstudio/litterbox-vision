## firmware/camera/main/Kconfig.projbuild
```kconfig
menu "CatVision Camera"
    config CATVISION_UDP_HOST
        string "UDP hub IPv4 address or .local hostname"
        default ""
    config CATVISION_UDP_PORT
        int "UDP hub port"
        default 5060
        range 1 65535
    config CATVISION_AUDIO_ENABLED
        bool "Capture microphone audio"
        default y
    config CATVISION_AUDIO_UDP_PORT
        int "UDP audio hub port"
        default 5061
        range 1 65535
    config CATVISION_OTA_SERVER_PORT
        int "OTA hub HTTP port"
        default 8000
        range 1 65535
    config CATVISION_OTA_SELF_TEST_FAILURE
        bool "Force OTA startup self-test failure (diagnostic only)"
        default n
endmenu
```

## firmware/camera/sdkconfig.defaults.example
```kconfig
CONFIG_IDF_TARGET="esp32s3"
CONFIG_BOOTLOADER_OFFSET_IN_FLASH=0x0
CONFIG_ESPTOOLPY_FLASHMODE_QIO=y
CONFIG_ESPTOOLPY_FLASHSIZE_16MB=y
CONFIG_PARTITION_TABLE_CUSTOM=y
CONFIG_PARTITION_TABLE_CUSTOM_FILENAME="partitions.csv"
CONFIG_PARTITION_TABLE_FILENAME="partitions.csv"
CONFIG_PARTITION_TABLE_OFFSET=0x8000
CONFIG_FREERTOS_HZ=1000
CONFIG_SPIRAM=y
CONFIG_SPIRAM_MODE_OCT=y
CONFIG_SPIRAM_XIP_FROM_PSRAM=y
CONFIG_SPIRAM_FETCH_INSTRUCTIONS=y
CONFIG_SPIRAM_RODATA=y
CONFIG_SPIRAM_SPEED_80M=y
CONFIG_SPIRAM_USE_MALLOC=y
CONFIG_SPIRAM_TRY_ALLOCATE_WIFI_LWIP=y
CONFIG_SPIRAM_MALLOC_RESERVE_INTERNAL=32768
CONFIG_CATVISION_UDP_HOST="replace-with-mac-host.local"
CONFIG_CATVISION_UDP_PORT=5060
CONFIG_CATVISION_AUDIO_UDP_PORT=5061
CONFIG_CATVISION_WIFI_SSID="replace-with-wifi-ssid"
CONFIG_CATVISION_WIFI_PASSWORD="replace-with-wifi-password"
CONFIG_CATVISION_SERVER_URL="http://replace-with-mac-host.local:8000"
CONFIG_CATVISION_DEVICE_TOKEN="replace-with-random-lan-token"
CONFIG_BOOTLOADER_APP_ROLLBACK_ENABLE=y
```

## firmware/common/components/catvision_display/Kconfig.projbuild
```kconfig
menu "CatVision Display"
    config CATVISION_LCD_PCLK_HZ
        int "LCD QSPI pixel clock in Hz"
        default 80000000
        range 40000000 80000000
        help
            Pixel clock used by the CO5300 QSPI panels. The previous default was 40 MHz.
    config CATVISION_LVGL_TASK_PRIORITY
        int "LVGL task priority"
        default 6
        range 1 6
        help
            Allow controlled display scheduling comparisons; the adapter default is 6.
    config CATVISION_TOUCH_ENABLED
        bool "Initialize touch input"
        default y
        help
            Disable for display-only firmware that does not use touch input.
endmenu
```

## firmware/common/components/catvision_net/Kconfig
```kconfig
menu "CatVision Network"
    config CATVISION_WIFI_SSID
        string "Wi-Fi SSID"
        default ""
    config CATVISION_WIFI_PASSWORD
        string "Wi-Fi password"
        default ""
    config CATVISION_SERVER_URL
        string "Computer hub base URL"
        default "http://192.168.1.100:8000"
    config CATVISION_DEVICE_TOKEN
        string "Shared LAN device token"
        default ""
    config CATVISION_RAW_STREAM_PORT
        int "Acknowledged live stream TCP port"
        default 8001
        range 1024 65535
endmenu
```

## firmware/stats_2p16/sdkconfig.defaults.example
```kconfig
CONFIG_IDF_TARGET="esp32s3"
CONFIG_BOOTLOADER_OFFSET_IN_FLASH=0x0
CONFIG_ESPTOOLPY_FLASHMODE_QIO=y
CONFIG_ESPTOOLPY_FLASHSIZE_16MB=y
CONFIG_PARTITION_TABLE_CUSTOM=y
CONFIG_PARTITION_TABLE_CUSTOM_FILENAME="partitions.csv"
CONFIG_PARTITION_TABLE_FILENAME="partitions.csv"
CONFIG_PARTITION_TABLE_OFFSET=0x8000
CONFIG_FREERTOS_HZ=1000
CONFIG_SPIRAM=y
CONFIG_SPIRAM_MODE_OCT=y
CONFIG_SPIRAM_XIP_FROM_PSRAM=y
CONFIG_SPIRAM_FETCH_INSTRUCTIONS=y
CONFIG_SPIRAM_RODATA=y
CONFIG_SPIRAM_SPEED_80M=y
CONFIG_SPIRAM_USE_MALLOC=y
CONFIG_CATVISION_LCD_PCLK_HZ=80000000
CONFIG_CATVISION_LVGL_TASK_PRIORITY=6
# CONFIG_CATVISION_TOUCH_ENABLED is not set
CONFIG_CATVISION_WIFI_SSID="replace-with-wifi-ssid"
CONFIG_CATVISION_WIFI_PASSWORD="replace-with-wifi-password"
CONFIG_CATVISION_SERVER_URL="http://replace-with-mac-host.local:8000"
CONFIG_CATVISION_DEVICE_TOKEN="replace-with-random-lan-token"
```
